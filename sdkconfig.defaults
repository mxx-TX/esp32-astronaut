## sdkconfig.defaults
```kconfig
CONFIG_IDF_TARGET="esp32s3"
CONFIG_ESPTOOLPY_FLASHSIZE_32MB=y
CONFIG_ESPTOOLPY_FLASHSIZE="32MB"
CONFIG_ESP32S3_SPIRAM_SUPPORT=y
CONFIG_SPIRAM=y
CONFIG_SPIRAM_MODE_OCT=y
CONFIG_SPIRAM_SPEED_80M=y
CONFIG_SPIRAM_FETCH_INSTRUCTIONS=y
CONFIG_SPIRAM_RODATA=y
CONFIG_SPIRAM_MALLOC_ALWAYSINTERNAL=16384
CONFIG_SPIRAM_USE_CAPS_ALLOC=y
CONFIG_SPIRAM_USE_MALLOC=y
CONFIG_SPIRAM_ALLOW_BSS_SEG_EXTERNAL_MEMORY=y
CONFIG_ESP_MAIN_TASK_STACK_SIZE=8192
CONFIG_ESP_MAIN_TASK_AFFINITY_CPU0=y
CONFIG_FREERTOS_HZ=1000
CONFIG_FATFS_LFN_STACK=y
CONFIG_FATFS_MAX_LFN=255
CONFIG_FATFS_FS_LOCK=4
CONFIG_FATFS_TIMEOUT_MS=3000
CONFIG_FATFS_PER_FILE_CACHE=y
CONFIG_FATFS_ALLOC_PREFER_EXTRAM=y
CONFIG_SPI_MASTER_ISR_IN_IRAM=y
CONFIG_I2C_ISR_IRAM_SAFE=y
CONFIG_I2S_ISR_IRAM_SAFE=y
CONFIG_PARTITION_TABLE_CUSTOM=y
CONFIG_PARTITION_TABLE_CUSTOM_FILENAME="partitions.csv"
CONFIG_LV_COLOR_DEPTH=16
CONFIG_LV_COLOR_16_SWAP=n
CONFIG_LV_USE_PERF_MONITOR=n
CONFIG_LV_USE_DRAW_SW=y
CONFIG_LV_DRAW_BUF_STRIDE_ALIGN=1
CONFIG_LV_USE_FREETYPE=n
CONFIG_LV_MEM_SIZE_KILOBYTES=512

CONFIG_LV_USE_CLIB_MALLOC=y

CONFIG_LV_MEMCPY_MEMSET_STD=y
CONFIG_ESP_WIFI_STA_RSSI_THRESHOLD=-80
CONFIG_ESP_WIFI_AUTH_OPEN=y
CONFIG_ESP_WIFI_AUTH_WPA2_PSK=y
CONFIG_BT_ENABLED=y
CONFIG_BT_BLE_ENABLED=y
CONFIG_BT_NIMBLE_ENABLED=y
CONFIG_ESP_HTTP_CLIENT_ENABLE_HTTPS=n
CONFIG_LV_FONT_MONTSERRAT_24=y
CONFIG_PARTITION_TABLE_CUSTOM=y
CONFIG_PARTITION_TABLE_CUSTOM_FILENAME="partitions.csv"


CONFIG_LV_DRAW_SW_SUPPORT_RGB565_SWAPPED=y
CONFIG_LV_FONT_MONTSERRAT_30=y

CONFIG_ESP_HTTPS_OTA_ALLOW_HTTP=y

CONFIG_BOOTLOADER_APP_ROLLBACK_ENABLE=y

CONFIG_BOOTLOADER_SKIP_VALIDATE_IN_DEEP_SLEEP=y
CONFIG_ESP32S3_DEEP_SLEEP_WAKEUP_DELAY=0
```
